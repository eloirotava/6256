## Documentation/devicetree/bindings/net/wireless/ssv,ssv6256.yaml
```yaml
# SPDX-License-Identifier: (GPL-2.0-only OR BSD-2-Clause)
%YAML 1.2
---
$id: http://devicetree.org/schemas/net/wireless/ssv,ssv6256.yaml#
$schema: http://devicetree.org/meta-schemas/core.yaml#

title: iComm SSV6256 SDIO wireless LAN

maintainers:
  - Eloi Rotava <eloi@rotava.com>

description:
  The SSV6256 is an 802.11b/g/n chip with an SDIO interface.  The node
  describes SDIO function 1 and is a child of the MMC host.  Modules
  whose e-fuse holds no MAC address take it from this node.  The bus
  clock is the one negotiated by the MMC core, lowered to 25 MHz only
  while the firmware is uploaded; limit it with the host's
  max-frequency if needed.

allOf:
  - $ref: ieee80211.yaml#

properties:
  compatible:
    const: ssv,ssv6256

  reg:
    description: SDIO function number.
    const: 1

  ssv,xtal-hz:
    description: Frequency of the crystal on the module.
    enum: [24000000, 26000000, 40000000]
    default: 24000000

  local-mac-address: true
  mac-address: true

required:
  - compatible
  - reg

unevaluatedProperties: false

examples:
  - |
    mmc {
        #address-cells = <1>;
        #size-cells = <0>;

        wifi@1 {
            compatible = "ssv,ssv6256";
            reg = <1>;
            local-mac-address = [00 11 22 33 44 55];
        };
    };
```

## Kconfig
```kconfig
# SPDX-License-Identifier: GPL-2.0-only
config SSV6256
	tristate "iComm SSV6256 SDIO wireless support"
	depends on MAC80211 && MMC
	help
	  This driver supports the iComm SSV6256 802.11b/g/n SDIO chip
	  (the "Turismo" family, which identifies itself as SSV6006C),
	  found in TV boxes, in station mode.

	  It needs the firmware file ssv/ssv6x5x-sw.bin.

	  If you choose to build a module, it'll be called ssv6256.
```
